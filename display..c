// ============================================================
// display.c
// Framebuffer management and all drawing functions.
// Sits between the game code and the DVI/TFT hardware layers.
// ============================================================

#include "display.h"
#include "dvi.h"
#include "pico/stdlib.h"
#include <string.h>

// ------------------------------------------------------------
// Framebuffers
// Two buffers for double buffering - game draws into back,
// DMA reads from front. They swap at vsync.
// ------------------------------------------------------------
static uint8_t framebuffer_a[SCREEN_WIDTH * SCREEN_HEIGHT];
static uint8_t framebuffer_b[SCREEN_WIDTH * SCREEN_HEIGHT];

static uint8_t *frame_back    = framebuffer_a; // game draws here
static uint8_t *frame_display = framebuffer_b; // DMA reads here

// Pending flip flag - set by display_flip(), cleared by vsync IRQ
static volatile bool flip_pending = false;

// ------------------------------------------------------------
// 8x8 bitmap font
// Each character is 8 bytes, one byte per row, MSB = leftmost pixel
// ASCII 32 (space) through 127, stored as font_data[char - 32][row]
// ------------------------------------------------------------
static const uint8_t font_data[96][8] = {
    {0x00,0x00,0x00,0x00,0x00,0x00,0x00,0x00}, // space
    {0x18,0x3C,0x3C,0x18,0x18,0x00,0x18,0x00}, // !
    {0x36,0x36,0x00,0x00,0x00,0x00,0x00,0x00}, // "
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    {0xFF,0xFF,0xFF,0xFF,0xFF,0xFF,0xFF,0xFF}, // DEL (filled block)
};

// ============================================================
// display_init
// ============================================================
void display_init(void) {
    // Clear both buffers to black
    memset(framebuffer_a, COLOR_BLACK, sizeof(framebuffer_a));
    memset(framebuffer_b, COLOR_BLACK, sizeof(framebuffer_b));

    frame_back    = framebuffer_a;
    frame_display = framebuffer_b;
    flip_pending  = false;

    // Initialize DVI hardware
    dvi_init();
    dvi_set_display_buffer(frame_display);
    dvi_start();
}

// ============================================================
// display_clear
// Fill the back buffer with a solid color
// ============================================================
void display_clear(uint8_t color) {
    memset(frame_back, color, SCREEN_WIDTH * SCREEN_HEIGHT);
}

// ============================================================
// display_flip
// Queue a buffer swap and block until vsync happens
// ============================================================
void display_flip(void) {
    // Wait for vsync
    while (!dvi_vsync_occurred()) {
        __wfi(); // sleep until next interrupt
    }

    // Swap the pointers
    uint8_t *tmp  = frame_display;
    frame_display = frame_back;
    frame_back    = tmp;

    // Tell DVI to read from the new display buffer
    dvi_set_display_buffer(frame_display);
}

// ============================================================
// display_is_docked
// ============================================================
bool display_is_docked(void) {
    return gpio_get(DOCK_DETECT_PIN);
}

// ============================================================
// display_get_back_buffer
// ============================================================
uint8_t *display_get_back_buffer(void) {
    return frame_back;
}

// ============================================================
// draw_pixel
// Bounds-checked single pixel write into back buffer
// ============================================================
void draw_pixel(int x, int y, uint8_t color) {
    if (x < 0 || x >= SCREEN_WIDTH || y < 0 || y >= SCREEN_HEIGHT) return;
    frame_back[y * SCREEN_WIDTH + x] = color;
}

// ============================================================
// draw_rect
// Filled rectangle
// ============================================================
void draw_rect(int x, int y, int w, int h, uint8_t color) {
    // Clamp to screen bounds
    int x0 = x < 0 ? 0 : x;
    int y0 = y < 0 ? 0 : y;
    int x1 = (x + w) > SCREEN_WIDTH  ? SCREEN_WIDTH  : (x + w);
    int y1 = (y + h) > SCREEN_HEIGHT ? SCREEN_HEIGHT : (y + h);

    for (int row = y0; row < y1; row++) {
        memset(&frame_back[row * SCREEN_WIDTH + x0], color, x1 - x0);
    }
}

// ============================================================
// draw_rect_outline
// Rectangle border only
// ============================================================
void draw_rect_outline(int x, int y, int w, int h, uint8_t color) {
    draw_hline(x,         y,         w, color); // top
    draw_hline(x,         y + h - 1, w, color); // bottom
    draw_vline(x,         y,         h, color); // left
    draw_vline(x + w - 1, y,         h, color); // right
}

// ============================================================
// draw_hline
// Horizontal line - uses memset so it is very fast
// ============================================================
void draw_hline(int x, int y, int w, uint8_t color) {
    if (y < 0 || y >= SCREEN_HEIGHT) return;
    int x0 = x < 0 ? 0 : x;
    int x1 = (x + w) > SCREEN_WIDTH ? SCREEN_WIDTH : (x + w);
    if (x1 <= x0) return;
    memset(&frame_back[y * SCREEN_WIDTH + x0], color, x1 - x0);
}

// ============================================================
// draw_vline
// Vertical line
// ============================================================
void draw_vline(int x, int y, int h, uint8_t color) {
    if (x < 0 || x >= SCREEN_WIDTH) return;
    int y0 = y < 0 ? 0 : y;
    int y1 = (y + h) > SCREEN_HEIGHT ? SCREEN_HEIGHT : (y + h);
    for (int row = y0; row < y1; row++) {
        frame_back[row * SCREEN_WIDTH + x] = color;
    }
}

// ============================================================
// draw_line
// Arbitrary line between two points using Bresenham's algorithm
// ============================================================
void draw_line(int x0, int y0, int x1, int y1, uint8_t color) {
    int dx  =  (x1 > x0 ? x1 - x0 : x0 - x1);
    int dy  = -(y1 > y0 ? y1 - y0 : y0 - y1);
    int sx  = x0 < x1 ? 1 : -1;
    int sy  = y0 < y1 ? 1 : -1;
    int err = dx + dy;

    while (1) {
        draw_pixel(x0, y0, color);
        if (x0 == x1 && y0 == y1) break;
        int e2 = 2 * err;
        if (e2 >= dy) { err += dy; x0 += sx; }
        if (e2 <= dx) { err += dx; y0 += sy; }
    }
}

// ============================================================
// draw_circle
// Circle outline using Bresenham's midpoint algorithm
// ============================================================
void draw_circle(int cx, int cy, int r, uint8_t color) {
    int x = 0, y = r, d = 1 - r;
    while (x <= y) {
        draw_pixel(cx + x, cy + y, color);
        draw_pixel(cx - x, cy + y, color);
        draw_pixel(cx + x, cy - y, color);
        draw_pixel(cx - x, cy - y, color);
        draw_pixel(cx + y, cy + x, color);
        draw_pixel(cx - y, cy + x, color);
        draw_pixel(cx + y, cy - x, color);
        draw_pixel(cx - y, cy - x, color);
        if (d < 0) d += 2 * x + 3;
        else { d += 2 * (x - y) + 5; y--; }
        x++;
    }
}

// ============================================================
// draw_circle_filled
// Filled circle - draws horizontal spans between circle edges
// ============================================================
void draw_circle_filled(int cx, int cy, int r, uint8_t color) {
    int x = 0, y = r, d = 1 - r;
    while (x <= y) {
        draw_hline(cx - x, cy + y, x * 2 + 1, color);
        draw_hline(cx - x, cy - y, x * 2 + 1, color);
        draw_hline(cx - y, cy + x, y * 2 + 1, color);
        draw_hline(cx - y, cy - x, y * 2 + 1, color);
        if (d < 0) d += 2 * x + 3;
        else { d += 2 * (x - y) + 5; y--; }
        x++;
    }
}

// ============================================================
// draw_sprite
// Copy a raw w*h pixel array into the back buffer at (x, y)
// ============================================================
void draw_sprite(int x, int y, int w, int h, const uint8_t *data) {
    for (int row = 0; row < h; row++) {
        int screen_y = y + row;
        if (screen_y < 0 || screen_y >= SCREEN_HEIGHT) continue;
        for (int col = 0; col < w; col++) {
            int screen_x = x + col;
            if (screen_x < 0 || screen_x >= SCREEN_WIDTH) continue;
            frame_back[screen_y * SCREEN_WIDTH + screen_x] = data[row * w + col];
        }
    }
}

// ============================================================
// draw_sprite_transparent
// Same as draw_sprite but skips pixels matching transparent_color
// ============================================================
void draw_sprite_transparent(int x, int y, int w, int h,
                              const uint8_t *data, uint8_t transparent_color) {
    for (int row = 0; row < h; row++) {
        int screen_y = y + row;
        if (screen_y < 0 || screen_y >= SCREEN_HEIGHT) continue;
        for (int col = 0; col < w; col++) {
            int screen_x = x + col;
            if (screen_x < 0 || screen_x >= SCREEN_WIDTH) continue;
            uint8_t pixel = data[row * w + col];
            if (pixel != transparent_color) {
                frame_back[screen_y * SCREEN_WIDTH + screen_x] = pixel;
            }
        }
    }
}

// ============================================================
// draw_char
// Draw one ASCII character at (x, y) using the 8x8 bitmap font
// ============================================================
void draw_char(int x, int y, char c, uint8_t color) {
    if (c < 32 || c > 127) return;
    const uint8_t *glyph = font_data[c - 32];
    for (int row = 0; row < 8; row++) {
        uint8_t bits = glyph[row];
        for (int col = 0; col < 8; col++) {
            if (bits & (0x80 >> col)) {
                draw_pixel(x + col, y + row, color);
            }
        }
    }
}

// ============================================================
// draw_string
// Draw a null-terminated string starting at (x, y)
// Characters are 8 pixels wide with 1 pixel spacing
// ============================================================
void draw_string(int x, int y, const char *str, uint8_t color) {
    int cursor_x = x;
    while (*str) {
        if (*str == '\n') {
            cursor_x = x;
            y += 9; // 8 pixels tall + 1 pixel gap
        } else {
            draw_char(cursor_x, y, *str, color);
            cursor_x += 9; // 8 pixels wide + 1 pixel gap
        }
        str++;
    }
}